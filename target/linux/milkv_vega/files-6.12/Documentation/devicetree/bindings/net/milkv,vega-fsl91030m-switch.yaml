## target/linux/milkv_vega/files-6.12/Documentation/devicetree/bindings/net/milkv,vega-fsl91030m-switch.yaml
```yaml
# SPDX-License-Identifier: (GPL-2.0-only OR BSD-2-Clause)
%YAML 1.2
---
$id: http://devicetree.org/schemas/net/milkv,vega-fsl91030m-switch.yaml#
$schema: http://devicetree.org/meta-schemas/core.yaml#

title: FisiLink FSL91030M Ethernet switch fabric

maintainers:
  - OpenWrt Developers <openwrt-devel@lists.openwrt.org>

description:
  The FSL91030M switch fabric provides the L2 forwarding core used on the
  Milk-V Vega board.  The Linux driver exposes the supported control plane
  through bridge and switchdev netdev interfaces.

properties:
  $nodename:
    pattern: "^switch(@.*)?$"

  compatible:
    const: milkv,vega-fsl91030m-switch

  reg:
    items:
      - description: CPU-direct switch MMIO window
      - description: SoC DMA register window used for switch table access
      - description: DMA scratch window used for switch table access
    description:
      The switch window is the Milk-V Vega switch/TDMA aperture at
      0x60000000.  The dma-scratch window must be at least 0x1000 bytes and
      8-byte aligned.

  reg-names:
    items:
      - const: switch
      - const: dma
      - const: dma-scratch

required:
  - compatible
  - reg
  - reg-names

additionalProperties: false

examples:
  - |
    soc {
        #address-cells = <2>;
        #size-cells = <2>;

        switch@60000000 {
            compatible = "milkv,vega-fsl91030m-switch";
            reg = <0x0 0x60000000 0x0 0x07100000>,
                  <0x0 0x10017000 0x0 0x1000>,
                  <0x0 0x40010000 0x0 0x1000>;
            reg-names = "switch", "dma", "dma-scratch";
        };
    };
```

## target/linux/milkv_vega/files-6.12/Documentation/devicetree/bindings/net/milkv,vega-xy1000-pdma.yaml
```yaml
# SPDX-License-Identifier: (GPL-2.0-only OR BSD-2-Clause)
%YAML 1.2
---
$id: http://devicetree.org/schemas/net/milkv,vega-xy1000-pdma.yaml#
$schema: http://devicetree.org/meta-schemas/core.yaml#

title: FisiLink XY1000 packet-DMA host interface

maintainers:
  - OpenWrt Developers <openwrt-devel@lists.openwrt.org>

description:
  The XY1000 packet-DMA block moves Ethernet frames between the host CPU and
  the FSL91030M switch fabric through an 8-byte private packet header. It does
  not configure switch-fabric forwarding policy; the switch fabric driver owns
  CPU-port admission and egress rules.

properties:
  $nodename:
    pattern: "^packet-dma(@.*)?$"

  compatible:
    const: milkv,vega-xy1000-pdma

  reg:
    items:
      - description: Packet-DMA MMIO register window.
      - description: Fixed packet scratch buffer window.

  reg-names:
    items:
      - const: regs
      - const: buffer

  interrupts:
    minItems: 3
    maxItems: 3
    description: TX completion, RX completion, and RX request interrupts.

  interrupt-names:
    items:
      - const: tx-end
      - const: rx-end
      - const: rx-req

  local-mac-address: true

required:
  - compatible
  - reg
  - reg-names
  - interrupts
  - interrupt-names

additionalProperties: false

examples:
  - |
    packet-dma@67800000 {
        compatible = "milkv,vega-xy1000-pdma";
        reg = <0x0 0x67800000 0x0 0x1000>,
              <0x0 0x40000000 0x0 0x8000>;
        reg-names = "regs", "buffer";
        interrupt-parent = <&plic0>;
        interrupts = <10>, <11>, <12>;
        interrupt-names = "tx-end", "rx-end", "rx-req";
        local-mac-address = [00 02 a3 f2 10 00];
    };
```

## target/linux/milkv_vega/files-6.12/drivers/net/ethernet/fisilink/Kconfig
```kconfig
# SPDX-License-Identifier: GPL-2.0-only
config NET_VENDOR_FISILINK
	bool "FisiLink devices"
	default y
	depends on RISCV || COMPILE_TEST
	help
	  Say Y here to enable support for Ethernet controllers and switch
	  fabrics made by FisiLink.

	  This option enables the FisiLink Ethernet driver menu. Individual
	  drivers still need to be selected below.

if NET_VENDOR_FISILINK

config FSL91030M_SWITCH
	tristate "FisiLink FSL91030M Ethernet switch fabric"
	depends on HAS_IOMEM
	depends on OF
	depends on BRIDGE
	depends on NET_SWITCHDEV
	select XY1000_PDMA
	help
	  This driver supports the FSL91030M L2 switch fabric used on the
	  Milk-V Vega board. It exposes bridge membership, bridge port-state,
	  and bridge ageing through standard Linux bridge and switchdev
	  interfaces. Ageing time zero disables hardware ageing; positive bridge
	  clock ticks are rounded up to the hardware's whole-second granularity
	  and clamped to the verified 1..3600 second range.

	  The driver binds to the Milk-V Vega FSL91030M devicetree compatible
	  string and creates Linux-visible netdev control ports for the
	  supported board datapath.

config XY1000_PDMA
	tristate "FisiLink XY1000 packet-DMA host interface"
	depends on HAS_IOMEM
	depends on OF
	help
	  This driver supports the packet-DMA host interface used on the
	  Milk-V Vega board. It exposes a normal Linux Ethernet netdev for
	  packets that the switch fabric explicitly steers to the CPU packet
	  path.

	  The driver owns only the packet-DMA MMIO block, IRQs, DMA buffers,
	  and the private packet header. It does not program FSL91030M switch
	  fabric tables or enable a CPU port by itself.

endif # NET_VENDOR_FISILINK
```
